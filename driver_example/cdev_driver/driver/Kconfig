## driver_example/cdev_driver/driver/Kconfig
```kconfig
config GLOBALMEM
        tristate "GLOBALMEM ......"
    depends on GPIOLIB
        default y
        help
                Select this option if your Touch-S board needs to run GLOBALMEM
```

## driver_example/i2c_audio_driver/driver/Kconfig
```kconfig
config UDA1380
        tristate "uda1380 test "
    depends on I2C
        default y
        help
                Select this option if your board need run audio
```

## driver_example/noblockio_driver/driver/Kconfig
```kconfig
config KEY
        tristate "KEY Test "
    depends on GPIOLIB
        default y
        help
                Select this option if your Touch-S board needs to run GLOBALMEM
```

## driver_example/spiled_driver/driver/Kconfig
```kconfig
config LED
        tristate "LED Test "
    depends on GPIOLIB
        default y
        help
                Select this option if your Touch-S board needs to run GLOBALMEM
```
